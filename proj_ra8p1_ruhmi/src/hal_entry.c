#include "hal_data.h"
#include "compute_sub_0000.h"
#include "digit_samples.h"
#include "time_counter.h"
#include "SEGGER_RTT/SEGGER_RTT.h"

/* Input buffer */
static uint8_t input_buffer[784];
/* Output buffer */
static uint8_t output_buffer[10];

/* Intermediate buffer */
static uint8_t compute_buffer[kBufferSize_sub_0000];

/* 总共10张图片 0 - 10，每张图片像素为 28 * 28 */
#define NUM_SAMPLES 10

static uint8_t *sample_images[NUM_SAMPLES] = {
    (uint8_t *)&digit4[0],
    (uint8_t *)&digit6[0],
    (uint8_t *)&digit8[0],
    (uint8_t *)&digit0[0],
    (uint8_t *)&digit2[0],
    (uint8_t *)&digit1[0],
    (uint8_t *)&digit3[0],
    (uint8_t *)&digit7[0],
    (uint8_t *)&digit9[0],
    (uint8_t *)&digit5[0],
};


static uint8_t *result_images[NUM_SAMPLES] = {
    (uint8_t *)&digit0[0],
    (uint8_t *)&digit1[0],
    (uint8_t *)&digit2[0],
    (uint8_t *)&digit3[0],
    (uint8_t *)&digit4[0],
    (uint8_t *)&digit5[0],
    (uint8_t *)&digit6[0],
    (uint8_t *)&digit7[0],
    (uint8_t *)&digit8[0],
    (uint8_t *)&digit9[0],
};

uint8_t *output_ptr = NULL;
uint8_t *img = NULL;

volatile uint32_t g_dwt_start_0 = 0;
volatile uint32_t g_dwt_end_0 = 0;
volatile uint32_t g_dwt_start_1 = 0;
volatile uint32_t g_dwt_end_1 = 0;
volatile uint32_t g_dwt_diff = 0;
volatile uint8_t result=0;
volatile uint8_t cnt=0;

FSP_CPP_HEADER
void R_BSP_WarmStart(bsp_warm_start_event_t event);
FSP_CPP_FOOTER

static void invalidate_dcache_range(void *addr, size_t len)
{
    // 假设 cache line = 32 bytes，按需修改为实际值
    const uintptr_t line = 32U;
    uintptr_t start = (uintptr_t)addr & ~(line - 1U);
    uintptr_t end = ((uintptr_t)addr + len + (line - 1U)) & ~(line - 1U);
    size_t size = end - start;
    SCB_InvalidateDCache_by_Addr((uint32_t *)start, (int)size);
}

void mnist_inference(uint8_t *p)
{
    memcpy(input_buffer, p, 28*28);
    TimeCounter_CountReset();
    g_dwt_start_0 = TimeCounter_CurrentCountGet();
    // RUN MODEL
    compute_sub_0000(compute_buffer, input_buffer, output_buffer);
    g_dwt_end_0 = TimeCounter_CurrentCountGet();
    g_dwt_diff = g_dwt_end_0 - g_dwt_start_0;
    SEGGER_RTT_printf(0, "\r\nDWT Inference took %d cycles\r\n", g_dwt_diff);

    invalidate_dcache_range((void*)output_ptr, 10); // 10 = 输出字节数

    result = 0;
    for (cnt = 0; cnt < 10; cnt++)
    {
        SEGGER_RTT_printf(0, "Output %d: %d\r\n", cnt,output_buffer[cnt]);
        if(output_buffer[cnt]==0xFF)
        {
            result = cnt;
            SEGGER_RTT_printf(0, "recognized! idx is %d\r\n",result);
        }
    }
}

void print_digi(int idx)
{
    img = result_images[idx];
    for(int i=0;i<28*28;i++)
    {
         if (i % 28 == 0 && i != 0) {
             SEGGER_RTT_printf(0, "\n");
         }
         if (img[i] == 0x00) {
             SEGGER_RTT_printf(0, "*");
         }
         else
         {
             SEGGER_RTT_printf(0, "0");
         }

    }
    SEGGER_RTT_printf(0, "\n");
}

/*******************************************************************************************************************//**
 * main() is generated by the RA Configuration editor and is used to generate threads if an RTOS is used.  This function
 * is called by main() when no RTOS is used.
 **********************************************************************************************************************/
void hal_entry(void)
{
    /* TODO: add your own code here */
    int i = 0;

    SEGGER_RTT_ConfigUpBuffer(0, NULL, NULL, 0, SEGGER_RTT_MODE_BLOCK_IF_FIFO_FULL);
    TimeCounter_Init();

    TimeCounter_Init();
    SEGGER_RTT_WriteString(0, "Start Inference\r\n");
    for(i=0;i<NUM_SAMPLES;i++)
    {
        SEGGER_RTT_printf(0, "\r\n--- Test Sample %d ---\r\n",i);
        mnist_inference(sample_images[i]);
        print_digi(result);
    }

#if BSP_TZ_SECURE_BUILD
    /* Enter non-secure code */
    R_BSP_NonSecureEnter();
#endif
}


#if BSP_TZ_SECURE_BUILD

FSP_CPP_HEADER
BSP_CMSE_NONSECURE_ENTRY void template_nonsecure_callable ();

/* Trustzone Secure Projects require at least one nonsecure callable function in order to build (Remove this if it is not required to build). */
BSP_CMSE_NONSECURE_ENTRY void template_nonsecure_callable ()
{

}
FSP_CPP_FOOTER

#endif
