#include "hal_data.h"
#include "SEGGER_RTT/SEGGER_RTT.h"
#include "stdio.h"
#include "model.h"
#include "model_io_data.h"
#include "digit_samples.h"
#include "time_counter.h"
#include "headfile.h"
#include "ov5640.h"




volatile bool g_uart9_tx_done = true;
void user_uart9_callback(uart_callback_args_t * p_args)
{
    if (NULL == p_args)
    {
        return;
    }

    if (UART_EVENT_TX_COMPLETE == p_args->event)
    {
        g_uart9_tx_done = true;
    }
}


int _write(int fd, char * pBuffer, int size)
{
    FSP_PARAMETER_NOT_USED(fd);

    if ((size <= 0) || (NULL == pBuffer))
    {
        return 0;
    }

    g_uart9_tx_done = false;
    g_uart9.p_api->write(g_uart9.p_ctrl, (uint8_t *) pBuffer, (uint32_t) size);

    while (!g_uart9_tx_done)
    {
        ;
    }

    return size;
}


/* 图像缓冲区 - QVGA (320x240) RGB565 格式 */
#define IMAGE_WIDTH  320
#define IMAGE_HEIGHT 240

static uint32_t g_image_buffer[IMAGE_WIDTH * IMAGE_HEIGHT]
    BSP_ALIGN_VARIABLE(32) BSP_PLACE_IN_SECTION(".sdram_noinit");

/* 总共10张图片 0 - 10，每张图片像素为 28 * 28 */
#define NUM_SAMPLES 10

static uint8_t *sample_images[NUM_SAMPLES] = {
    (uint8_t *)&digit4[0],
    (uint8_t *)&digit6[0],
    (uint8_t *)&digit8[0],
    (uint8_t *)&digit0[0],
    (uint8_t *)&digit2[0],
    (uint8_t *)&digit1[0],
    (uint8_t *)&digit3[0],
    (uint8_t *)&digit7[0],
    (uint8_t *)&digit9[0],
    (uint8_t *)&digit5[0],
};


static uint8_t *result_images[NUM_SAMPLES] = {
    (uint8_t *)&digit0[0],
    (uint8_t *)&digit1[0],
    (uint8_t *)&digit2[0],
    (uint8_t *)&digit3[0],
    (uint8_t *)&digit4[0],
    (uint8_t *)&digit5[0],
    (uint8_t *)&digit6[0],
    (uint8_t *)&digit7[0],
    (uint8_t *)&digit8[0],
    (uint8_t *)&digit9[0],
};

uint8_t *output_ptr = NULL;
uint8_t *img = NULL;

volatile uint32_t g_dwt_start_0 = 0;
volatile uint32_t g_dwt_end_0 = 0;
volatile uint32_t g_dwt_start_1 = 0;
volatile uint32_t g_dwt_end_1 = 0;
volatile uint32_t g_dwt_diff = 0;
volatile uint8_t result=0;
volatile uint8_t cnt=0;

FSP_CPP_HEADER
void R_BSP_WarmStart(bsp_warm_start_event_t event);
FSP_CPP_FOOTER

static void invalidate_dcache_range(void *addr, size_t len)
{
    // 假设 cache line = 32 bytes，按需修改为实际值
    const uintptr_t line = 32U;
    uintptr_t start = (uintptr_t)addr & ~(line - 1U);
    uintptr_t end = ((uintptr_t)addr + len + (line - 1U)) & ~(line - 1U);
    size_t size = end - start;
    SCB_InvalidateDCache_by_Addr((uint32_t *)start, (int)size);
}

void print_digi(int idx)
{
    img = result_images[idx];
    for(int i=0;i<28*28;i++)
    {
         if (i % 28 == 0 && i != 0) {
             SEGGER_RTT_printf(0, "\n");
         }
         if (img[i] == 0x00) {
             SEGGER_RTT_printf(0, "*");
         }
         else
         {
             SEGGER_RTT_printf(0, "0");
         }

    }
}

void mnist_inference(uint8_t *p)
{
    memcpy(GetModelInputPtr_serving_default_input_1_0(), p, model_serving_default_input_1_0_SIZE);

    TimeCounter_CountReset();
    g_dwt_start_0 = TimeCounter_CurrentCountGet();
    // RUN MODEL
    RunModel(false);
    g_dwt_end_0 = TimeCounter_CurrentCountGet();
    g_dwt_diff = g_dwt_end_0 - g_dwt_start_0;
    SEGGER_RTT_printf(0, "\r\nDWT Inference took %d cycles\r\n", g_dwt_diff);
    output_ptr = GetModelOutputPtr_StatefulPartitionedCall_0_70018();

    invalidate_dcache_range((void*)output_ptr, 10); // 10 = 输出字节数

    result = 0;
    for (cnt = 0; cnt < 10; cnt++)
    {
        SEGGER_RTT_printf(0, "Output %d: %d\r\n", cnt,output_ptr[cnt]);
        if(output_ptr[cnt]==0xFF)
        {
            result = cnt;
            SEGGER_RTT_printf(0, "recognized! idx is %d\r\n",result);
        }
    }
}
/*******************************************************************************************************************//**
 * main() is generated by the RA Configuration editor and is used to generate threads if an RTOS is used.  This function
 * is called by main() when no RTOS is used.
 **********************************************************************************************************************/
void hal_entry(void)
{
    /* TODO: add your own code here */
    uint8_t i = 0;

    R_BSP_SdramInit(true);

    // NPU Initialization
    SEGGER_RTT_ConfigUpBuffer(0, NULL, NULL, 0, SEGGER_RTT_MODE_BLOCK_IF_FIFO_FULL);
    int status = FSP_SUCCESS;
    status = RM_ETHOSU_Open(&g_rm_ethosu0_ctrl, &g_rm_ethosu0_cfg);
    if (status != FSP_SUCCESS) {
      SEGGER_RTT_WriteString(0, "Failed to start NPU\r\n");
      return;
    }

    TimeCounter_Init();
    SEGGER_RTT_WriteString(0, "Start Inference\r\n");


    /* TODO: add your own code here */
    fsp_err_t err;

    g_uart9.p_api->open(g_uart9.p_ctrl,g_uart9.p_cfg);


    /********************************************************************************************************/
    uint16_t chip_id = 0;

    /* 1. 初始化 OV5640 */
    err = ov5640_init();
    if (FSP_SUCCESS != err)
    {
        printf("OV5640 init failed: %d\r\n", err);
        while(1);  /* 初始化失败，停止 */
    }

    /* 2. 验证芯片 ID */
    err = ov5640_check_chip_id(&chip_id);
    if (FSP_SUCCESS == err)
    {
        printf("OV5640 Chip ID: 0x%04X\r\n", chip_id);
    }

    /* 3. 配置摄像头参数 */
    /* 设置分辨率为 QVGA (320x240) */
    err = ov5640_set_resolution(OV5640_RES_QVGA);
    if (FSP_SUCCESS != err)
    {
        printf("Set resolution failed: %d\r\n", err);
    }

    /* 设置输出格式为 RGB565 */
    err = ov5640_set_output_format(OV5640_FORMAT_RGB565);
    if (FSP_SUCCESS != err)
    {
        printf("Set format failed: %d\r\n", err);
    }

    printf("OV5640 configured successfully\r\n");

    R_BSP_SoftwareDelay(500, BSP_DELAY_UNITS_MILLISECONDS);  // 增加到500ms
    /* 4. 打开 CEU 外设 */
    err = g_ceu0.p_api->open(g_ceu0.p_ctrl, g_ceu0.p_cfg);
    if (FSP_SUCCESS != err && FSP_ERR_ALREADY_OPEN != err)
    {
        printf("CEU open failed: %d\r\n", err);
        while(1);
    }








    //测试图片使用
    for(i=0;i<NUM_SAMPLES;i++)
    {
        SEGGER_RTT_printf(0, "\r\n--- Test Sample %d ---\r\n",i);
        mnist_inference(sample_images[i]);
        print_digi(result);
    }

#if BSP_TZ_SECURE_BUILD
    /* Enter non-secure code */
    R_BSP_NonSecureEnter();
#endif
}

#if BSP_TZ_SECURE_BUILD

FSP_CPP_HEADER
BSP_CMSE_NONSECURE_ENTRY void template_nonsecure_callable ();

/* Trustzone Secure Projects require at least one nonsecure callable function in order to build (Remove this if it is not required to build). */
BSP_CMSE_NONSECURE_ENTRY void template_nonsecure_callable ()
{

}
FSP_CPP_FOOTER

#endif
