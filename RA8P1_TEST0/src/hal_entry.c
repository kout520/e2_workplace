#include "hal_data.h"
#include "headfile.h"
#include "ov5640.h"
#include "tjc_usart_hmi.h"
#include "AS608pro.h"
#include "pn532.h"

/* ===== 1ms 定时器回调 (FSP g_timer_1ms 中断) =====
 * 统一调度所有需要 1ms 时基的模块:
 *   - PN532:   超时计数 (g_system_tick)
 *   - AS608:   串口接收超时检测 (timeout_search_1ms)
 *   - ESP32:   软件 RTC 时基 (esp32_rtc_tick_1ms)
 */
void timer_1ms_callback(timer_callback_args_t *p_args)
{
    if (TIMER_EVENT_CYCLE_END == p_args->event)
    {
        g_system_tick();          // PN532 时基
        timeout_search_1ms();     // AS608 接收超时
        esp32_rtc_tick_1ms();     // 软件 RTC 走时
    }
}


#if (1 == BSP_MULTICORE_PROJECT) && BSP_TZ_SECURE_BUILD
bsp_ipc_semaphore_handle_t g_core_start_semaphore =
{
    .semaphore_num = 0
};
#endif

/* ===== 全局标志和变量 ===== */
volatile bool g_uart9_tx_done = true;
volatile int  motor_flag = 0;   // 开锁标志: 1/2/3=对应卡号, 0=无

/* ===== UART 回调 ===== */
void user_uart9_callback(uart_callback_args_t * p_args)
{
    if (NULL == p_args) { return; }
    if (UART_EVENT_TX_COMPLETE == p_args->event)
    {
        g_uart9_tx_done = true;
    }
}

/* ===== printf 重定向 (UART9) ===== */
int _write(int fd, char * pBuffer, int size)
{
    FSP_PARAMETER_NOT_USED(fd);
    if ((size <= 0) || (NULL == pBuffer)) { return 0; }
    g_uart9_tx_done = false;
    g_uart9.p_api->write(g_uart9.p_ctrl, (uint8_t *) pBuffer, (uint32_t) size);
    while (!g_uart9_tx_done) { ; }
    return size;
}

/* ===== 辅助函数 ===== */
void uart2_send_value(int val)
{
    char buf[32];
    sprintf(buf, "%d\r\n", val);
    // g_uart2.p_api->write(g_uart2.p_ctrl, (uint8_t *)buf, (uint32_t)strlen(buf));
}

void uart8_send_value(int val)
{
    char buf[32];
    sprintf(buf, "%d\r\n", val);
    // g_uart8.p_api->write(g_uart8.p_ctrl, (uint8_t *)buf, (uint32_t)strlen(buf));
}

void uart9_send_value(int val)
{
    printf("UART9 value: %d\r\n", val);
}

void dakai_clock_display(void)
{
    tjc_send_string("page clock");
}

/**
 * 考勤打卡统一处理: 同时通知 ESP32 (MQTT上报) 和语音模块 (播报)
 * @param id  考勤编号 1~6
 */
void attendance_check_in(uint8_t id)
{
    if (id < 1 || id > 6) return;

    /* 发送到 ESP32 → MQTT 上报 */
    esp32_send_attendance(id);

    /* 发送到语音模块 → 语音播报 */
    voice_send_attendance(id);
}


/*******************************************************************************************************************//**
 * main() is generated by the RA Configuration editor and is used to generate threads if an RTOS is used.  This function
 * is called by main() when no RTOS is used.
 **********************************************************************************************************************/

/* 图像缓冲区 - QVGA (320x240) RGB565 格式 */
#define IMAGE_WIDTH  320
#define IMAGE_HEIGHT 240

static uint16_t g_image_buffer[IMAGE_WIDTH * IMAGE_HEIGHT]
    BSP_ALIGN_VARIABLE(32) BSP_PLACE_IN_SECTION(".sdram_noinit");


/* ===== YUV422 颜色检测 ===== */
typedef enum { COLOR_NONE, COLOR_RED, COLOR_GREEN, COLOR_BLUE } color_t;

static const char* color_name(color_t c) {
    switch(c) {
        case COLOR_RED:   return "RED";
        case COLOR_GREEN: return "GREEN";
        case COLOR_BLUE:  return "BLUE";
        default:          return "NONE";
    }
}

/* 基于 YUV422 Cr/Cb 直方图统计识别主色, 阈值可调 */
static color_t detect_color(uint16_t *image, uint32_t w, uint32_t h)
{
    uint32_t r_cnt = 0, g_cnt = 0, b_cnt = 0;
    uint32_t total = w * h;

    for (uint32_t i = 0; i < total; i += 2)
    {
        int y0 = image[i]     & 0xFF;
        int u  = (image[i]   >> 8) & 0xFF;
        int y1 = image[i+1]   & 0xFF;
        int v  = (image[i+1] >> 8) & 0xFF;

        /* 忽略过暗/过亮的像素 */
        if (y0 < 40 || y0 > 230) goto next_pix;
        if (y1 < 40 || y1 > 230) goto next_pix;

        /* 红: Cr高(V>150)  Cb低(U<120) */
        if      (v > 150 && u < 120) { r_cnt++; r_cnt++; }
        /* 绿: Cr低(V<120) Cb低(U<120) */
        else if (v < 120 && u < 120) { g_cnt++; g_cnt++; }
        /* 蓝: Cr低(V<120) Cb高(U>135) */
        else if (v < 120 && u > 135) { b_cnt++; b_cnt++; }

next_pix: ;
    }

    uint32_t th = total / 20;  /* 至少 5% 的像素 */
    if      (r_cnt > th && r_cnt > g_cnt && r_cnt > b_cnt) return COLOR_RED;
    else if (g_cnt > th && g_cnt > r_cnt && g_cnt > b_cnt) return COLOR_GREEN;
    else if (b_cnt > th && b_cnt > r_cnt && b_cnt > g_cnt) return COLOR_BLUE;
    return COLOR_NONE;
}

void hal_entry(void)
{
    fsp_err_t err;

    /* ===== 0. 打开调试串口 UART9 ===== */
    g_uart9.p_api->open(g_uart9.p_ctrl, g_uart9.p_cfg);

    /* ===== 启动 1ms 定时器 (AS608 + PN532 时基) ===== */
    g_timer_1ms.p_api->open(g_timer_1ms.p_ctrl, g_timer_1ms.p_cfg);
    g_timer_1ms.p_api->start(g_timer_1ms.p_ctrl);

    /********************************************************************************************************/
    uint16_t chip_id = 0;

    /* ===== 1. 初始化 OV5640 摄像头 (I2C0) ===== */
    err = ov5640_init();
    if (FSP_SUCCESS != err)
    {
        printf("OV5640 init failed: %d\r\n", err);
        while(1);
    }

    /* ===== 2. 验证芯片 ID ===== */
    err = ov5640_check_chip_id(&chip_id);
    if (FSP_SUCCESS == err)
    {
        printf("OV5640 Chip ID: 0x%04X\r\n", chip_id);
    }
    /* ===== 3. 配置摄像头参数 ===== */
    err = ov5640_set_resolution(OV5640_RES_QVGA);
    if (FSP_SUCCESS != err) { printf("Set resolution failed: %d\r\n", err); }

    err = ov5640_set_output_format(OV5640_FORMAT_YUV422);
    if (FSP_SUCCESS != err) { printf("Set format failed: %d\r\n", err); }

    ov5640_write_reg(0x5186, 0x20);
    ov5640_write_reg(0x5187, 0x20);

    printf("OV5640 configured successfully\r\n");
    R_BSP_SoftwareDelay(500, BSP_DELAY_UNITS_MILLISECONDS);

    /* ===== 4. 打开 CEU 摄像头接口 ===== */
    err = g_ceu0.p_api->open(g_ceu0.p_ctrl, g_ceu0.p_cfg);
    if (FSP_SUCCESS != err && FSP_ERR_ALREADY_OPEN != err)
    {
        printf("CEU open failed: %d\r\n", err);
        while(1);
    }

    /* ===== 5. 打开 LCD 屏幕 ===== */
    LCD_Init();
    LCD_ShowString(10, 10, 220, 300, 24, RED, (u8*)"INIT_successfully!");

    /* ===== 6. 打开 TJC 串口屏 (USART6) ===== */
    UART_HIM_Init();
    /* ===== 7. 打开 AS608 指纹模块 (USART2) ===== */
    AS608_Init();
    printf("AS608 fingerprint module initialized\r\n");

    /* ===== 8. 打开 PN532 NFC 模块 (I2C2) ===== */
    PN532_INIT();
    R_BSP_SoftwareDelay(500, BSP_DELAY_UNITS_MILLISECONDS);

    /* ===== 9. 打开 ESP32 通信 (USART3, 115200bps) ===== */
    ESP32_Comm_Init();

    /* ===== 10. 打开天问语音模块 (USART1, 115200bps) ===== */
    Voice_Init();

    printf("INIT_successfully \r\n");
    R_BSP_SoftwareDelay(10, BSP_DELAY_UNITS_MILLISECONDS);
    /* 回读 OV5640 关键寄存器验证配置 */
    {
        uint8_t reg4300 = 0, reg501f = 0, reg3008 = 0;
        ov5640_read_reg(0x4300, &reg4300);
        ov5640_read_reg(0x501F, &reg501f);
        ov5640_read_reg(0x3008, &reg3008);
        printf("OV5640 regs: 0x4300=0x%02X 0x501F=0x%02X 0x3008=0x%02X\r\n",
               reg4300, reg501f, reg3008);
    }

    /* ================================================================
     *                       主 循 环  (优化版)
     *
     *  策略: 摄像头捕获期间做其他 I/O, 慢速外设降频轮询
     *  ================================================================ */
    uint32_t frame_cnt   = 0;
    uint32_t t9_count    = 0;
    uint32_t loop_cnt    = 0;
    uint8_t  tick_1s     = 0;

    while (1)
    {
        loop_cnt++;

        /* ================================================================
         *  A. 快速路径: 每轮迭代都执行 (微秒级)
         * ================================================================ */

        /* A1. 串口屏触摸事件 (环形缓冲区, 极快) */
        HIM_connection();

        /* A2. ESP32 通信数据处理 */
        esp32_process();

        /* A3. 处理 ESP32 接收到的命令 */
        {
            uint8_t cmd = esp32_get_command();
            switch (cmd) {
                case ESP32_CMD_LED_ON:
                    /* TODO: 控制 LED 打开 */
                    break;
                case ESP32_CMD_LED_OFF:
                    /* TODO: 控制 LED 关闭 */
                    break;
                case ESP32_CMD_DATE_SYNC:
                    printf("RTC date calibrated\r\n");
                    break;
                case ESP32_CMD_TIME_SYNC:
                    printf("RTC time calibrated\r\n");
                    break;
                case ESP32_CMD_WIFI_UP:
                case ESP32_CMD_WIFI_DOWN:
                default:
                    break;
            }
        }

        /* A4. RTC 秒变化 → 更新 t8.txt (约 1次/秒) */
        if (esp32_rtc_second_changed()) {
            char dt_buf[24];
            esp32_rtc_get_string(dt_buf, sizeof(dt_buf));
            tjc_send_txt("t8", "txt", dt_buf);
        }

        /* ================================================================
         *  B. 中速路径: 每 10 轮执行一次 (约 10ms 间隔)
         * ================================================================ */
        if (0 == (loop_cnt % 10)) {

            /* B1. NFC 刷卡检测 (I2C, 数ms) */
            PN532_connect();

            /* B2. 指纹检测 (UART + 传感器, 数ms) */
            finger_search();

            /* B3. t9 计数器更新 */
            tick_1s++;
            if (tick_1s >= 10) {
                tick_1s = 0;
                t9_count++;
                char buf[16];
                sprintf(buf, "%lu", t9_count);
                tjc_send_txt("t9", "txt", buf);
            }
        }

        /* ================================================================
         *  C. 摄像头捕获: 启动后利用等待时间处理快速 I/O
         * ================================================================ */
        memset(g_image_buffer, 0x00, sizeof(g_image_buffer));
        g_capture_complete = false;

        err = g_ceu0.p_api->captureStart(g_ceu0.p_ctrl, (uint8_t*)g_image_buffer);
        if (FSP_SUCCESS != err) {
            printf("Capture err: %d\r\n", err);
            continue;
        }

        /* 等待帧完成期间继续处理快速 I/O (替代原来的 SoftwareDelay 空转) */
        {
            uint32_t cap_timeout = 500; /* 500ms 超时 */
            while (!g_capture_complete && cap_timeout > 0) {
                /* 快速处理串口屏和 ESP32, 保持 UI 响应 */
                HIM_connection();
                esp32_process();

                /* 处理 ESP32 命令 (同上) */
                {
                    uint8_t cmd = esp32_get_command();
                    if (ESP32_CMD_LED_ON  == cmd) { /* TODO */ }
                    if (ESP32_CMD_LED_OFF == cmd) { /* TODO */ }
                }

                /* RTC 显示更新 */
                if (esp32_rtc_second_changed()) {
                    char dt_buf[24];
                    esp32_rtc_get_string(dt_buf, sizeof(dt_buf));
                    tjc_send_txt("t8", "txt", dt_buf);
                }

                cap_timeout--;
            }

            if (!g_capture_complete) {
                printf("Capture timeout\r\n");
                continue;
            }
        }

        frame_cnt++;
        SCB_InvalidateDCache_by_Addr((void *)g_image_buffer, sizeof(g_image_buffer));

        /* ================================================================
         *  D. 帧处理 (低频)
         * ================================================================ */

        /* D1. 颜色检测: 每 30 帧一次 */
        if (0 == (frame_cnt % 30)) {
            color_t c = detect_color(g_image_buffer, IMAGE_WIDTH, IMAGE_HEIGHT);
            printf("Detected: %s\r\n", color_name(c));
        }

        /* D2. LCD 显示 */
        LCD_ShowImage(0, 0, IMAGE_WIDTH, IMAGE_HEIGHT, g_image_buffer);
    }

    /* Wake up 2nd core if this is first core and we are inside a multicore project. */
#if (0 == _RA_CORE) && (1 == BSP_MULTICORE_PROJECT) && !BSP_TZ_NONSECURE_BUILD

#if BSP_TZ_SECURE_BUILD
    R_BSP_IpcSemaphoreTake(&g_core_start_semaphore);
#endif
    R_BSP_SecondaryCoreStart();
#if BSP_TZ_SECURE_BUILD
    while(FSP_ERR_IN_USE == R_BSP_IpcSemaphoreTake(&g_core_start_semaphore)) { ; }
#endif
#endif

#if (1 == _RA_CORE) && (1 == BSP_MULTICORE_PROJECT) && BSP_TZ_SECURE_BUILD
    R_BSP_IpcSemaphoreGive(&g_core_start_semaphore);
#endif

#if BSP_TZ_SECURE_BUILD
    R_BSP_NonSecureEnter();
#endif
}

#if BSP_TZ_SECURE_BUILD
FSP_CPP_HEADER
BSP_CMSE_NONSECURE_ENTRY void template_nonsecure_callable ();
BSP_CMSE_NONSECURE_ENTRY void template_nonsecure_callable ()
{
}
FSP_CPP_FOOTER
#endif
